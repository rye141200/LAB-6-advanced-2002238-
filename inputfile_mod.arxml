AUTOSAR XML
3 x :
  ContainerA
  ContainerB
  ContainerC
